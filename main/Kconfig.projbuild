## main/Kconfig.projbuild
```kconfig
menu "Toga Setup"

  config BLUETOOTH_DEVICE_NAME
  string "Bluetooth Device Name"
  default "Toga"
  help
      Bluetooth device name for advertising.

  config ESP_POST_ENDPOINT
  string "HTTP POST Endpoint"
  default "https://ldm-nodered.herokuapp.com/esp32"
  help
      URL endpoint for the POST message.

  config SLEEP_DURATION
  int "Deep Sleep Duration (seconds)"
  default 30
  help
      Deep sleep duration in seconds.

  config BLE_ADVERTISE_DURATION
  int "Advertising BLE Duration (seconds)"
  default 10
  help
      Advertising BLE Duration in seconds.

  config ZIGBEE_ENABLED
  bool "Enable Zigbee Transmission"
  default False
  help
      Enable Zigbee.

endmenu
```

## sdkconfig.defaults
```kconfig
# Use lower CPU frequency
CONFIG_ESP32_DEFAULT_CPU_FREQ_80=y

# Enable support for power management
CONFIG_PM_ENABLE=y

# Enable tickless idle mode
CONFIG_FREERTOS_USE_TICKLESS_IDLE=y

# Use RTC timer as reference
CONFIG_PM_USE_RTC_TIMER_REF=y

# Set default flashsize
CONFIG_ESPTOOLPY_FLASHSIZE_16MB=y
CONFIG_ESPTOOLPY_FLASHSIZE="16MB"
CONFIG_ESPTOOLPY_FLASHSIZE_DETECT=y

##
## Partition Table
##
## CONFIG_PARTITION_TABLE_SINGLE_APP is not set
## CONFIG_PARTITION_TABLE_TWO_OTA is not set
CONFIG_PARTITION_TABLE_CUSTOM=y
CONFIG_PARTITION_TABLE_CUSTOM_FILENAME="partitions.csv"
CONFIG_PARTITION_TABLE_FILENAME="partitions.csv"
CONFIG_PARTITION_TABLE_OFFSET=0x8000
CONFIG_PARTITION_TABLE_MD5=y
## end of Partition Table

# Enable Bluetooth Controller
CONFIG_BTDM_CTRL_MODE_BLE_ONLY=y
CONFIG_BTDM_CTRL_PINNED_TO_CORE=0

# Enable Bluetooth Modem Sleep
CONFIG_BTDM_MODEM_SLEEP=y
CONFIG_BTDM_MODEM_SLEEP_MODE_ORIG=y
CONFIG_BTDM_LPCLK_SEL_MAIN_XTAL=y

# Enable Bluetooth/BLE
CONFIG_BT_ENABLED=y
CONFIG_BT_BLUEDROID_ENABLED=y
CONFIG_BT_BLE_ENABLED=y
CONFIG_BT_BLE_BLUFI_ENABLE=y
CONFIG_BT_BLE_DYNAMIC_ENV_MEMORY=y
CONFIG_BT_GATTS_ENABLE=y

CONFIG_BT_CLASSIC_ENABLED=y
CONFIG_BT_SPP_ENABLED=y 

#
# RTCIO configuration
#
CONFIG_RTCIO_SUPPORT_RTC_GPIO_DESC=y
# end of RTCIO configuration
# end of Driver configurations


# Compiler options
#
# CONFIG_COMPILER_OPTIMIZATION_DEFAULT is not set
CONFIG_COMPILER_OPTIMIZATION_SIZE=y
# CONFIG_COMPILER_OPTIMIZATION_PERF is not set
# CONFIG_COMPILER_OPTIMIZATION_NONE is not set
CONFIG_COMPILER_OPTIMIZATION_ASSERTIONS_ENABLE=y
# CONFIG_COMPILER_OPTIMIZATION_ASSERTIONS_SILENT is not set
# CONFIG_COMPILER_OPTIMIZATION_ASSERTIONS_DISABLE is not set
# CONFIG_COMPILER_CXX_EXCEPTIONS is not set
# CONFIG_COMPILER_CXX_RTTI is not set
CONFIG_COMPILER_STACK_CHECK_MODE_NONE=y
# CONFIG_COMPILER_STACK_CHECK_MODE_NORM is not set
# CONFIG_COMPILER_STACK_CHECK_MODE_STRONG is not set
# CONFIG_COMPILER_STACK_CHECK_MODE_ALL is not set
# CONFIG_COMPILER_WARN_WRITE_STRINGS is not set
# CONFIG_COMPILER_DISABLE_GCC8_WARNINGS is not set
# CONFIG_COMPILER_DUMP_RTL_FILES is not set
# end of Compiler options
```
